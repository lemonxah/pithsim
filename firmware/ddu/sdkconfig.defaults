## firmware/ddu/sdkconfig.defaults
```kconfig
# --- pithddu defaults (ESP32-S3, Rust build) ---

# Console on UART0: the native USB-OTG peripheral is owned by our TinyUSB
# composite device (CDC + HID) and shares the D+/D- pins with USB-Serial-JTAG, so
# console can't use USB. Attach a 3.3V USB-UART adapter to UART0 to see logs.
CONFIG_ESP_CONSOLE_UART_DEFAULT=y

# Headroom for the main task.
CONFIG_ESP_MAIN_TASK_STACK_SIZE=8192

# 8 MB Octal PSRAM on the XIAO ESP32-S3 (ESP32-S3R8) — holds the two display
# framebuffers (480x320x2 = 300 KB each, added in Phase 4).
CONFIG_SPIRAM=y
CONFIG_SPIRAM_MODE_OCT=y
CONFIG_SPIRAM_SPEED_80M=y
# Add PSRAM to the regular heap so the 300 KB display framebuffers allocate there
# (large allocations spill to PSRAM; small ones stay in fast internal RAM).
CONFIG_SPIRAM_USE_MALLOC=y
CONFIG_SPIRAM_MALLOC_ALWAYSINTERNAL=4096
CONFIG_ESP_DEFAULT_CPU_FREQ_MHZ_240=y
CONFIG_FREERTOS_HZ=1000

# 8 MB flash with a custom partition table (partitions.csv): factory recovery app
# (pith-recovery, boots first) + dual-OTA main firmware. MUST match
# pith-recovery/partitions.csv so both images agree on the slot offsets. Rollback
# stays on so a bad OTA can't brick the main firmware (recovery is the deeper net).
# NOTE: if the esp-idf-sys synthetic-project-dir CSV path bites, set
# CONFIG_PARTITION_TABLE_CUSTOM_FILENAME to an absolute path to partitions.csv.
CONFIG_ESPTOOLPY_FLASHSIZE_8MB=y
CONFIG_ESPTOOLPY_FLASHSIZE="8MB"
CONFIG_PARTITION_TABLE_CUSTOM=y
CONFIG_PARTITION_TABLE_CUSTOM_FILENAME="partitions.csv"
CONFIG_BOOTLOADER_APP_ROLLBACK_ENABLE=y
```

## firmware/handbrake/sdkconfig.defaults
```kconfig
# --- pith-hb defaults (ESP32-S2, Rust build) ---

# Console on UART0: the native USB-OTG peripheral is owned by our TinyUSB
# composite device (CDC + HID) and S2 has no separate USB-Serial-JTAG
# peripheral to fall back on, so console can't use USB. Attach a 3.3V
# USB-UART adapter to UART0 to see logs.
CONFIG_ESP_CONSOLE_UART_DEFAULT=y

# 4 MB flash (Lolin S2 Mini) with a custom partition table: nvs + dual OTA
# app slots. The dashboard updates the device in place over HID (@OTA);
# espflash in ROM download mode (hold BOOT, tap RESET) is the recovery path
# and the one-time migration from the old single-factory layout.
CONFIG_ESPTOOLPY_FLASHSIZE_4MB=y
CONFIG_ESPTOOLPY_FLASHSIZE="4MB"
CONFIG_PARTITION_TABLE_CUSTOM=y
CONFIG_PARTITION_TABLE_CUSTOM_FILENAME="partitions.csv"

# Compile the ESP-IDF C side (FreeRTOS, drivers, TinyUSB) for speed — the USB
# device task and GPIO bit-banging for the HX711 live there.
CONFIG_COMPILER_OPTIMIZATION_PERF=y

# A failed boot after an OTA rolls back to the previous slot; the running
# image confirms itself via esp_ota_mark_app_valid_cancel_rollback().
CONFIG_BOOTLOADER_APP_ROLLBACK_ENABLE=y
```

## firmware/pedals/sdkconfig.defaults
```kconfig
# --- pith-pedals defaults (ESP32-S3, Rust build) ---

# Console on UART0: the native USB-OTG peripheral is owned by our TinyUSB
# composite device and shares the D+/D- pins with USB-Serial-JTAG, so
# console can't use USB. Attach a 3.3V USB-UART adapter to UART0 to see logs.
CONFIG_ESP_CONSOLE_UART_DEFAULT=y

# 4 MB flash with a custom partition table: nvs + dual OTA app slots. The
# dashboard updates the device in place over HID (@OTA); espflash in ROM
# download mode (hold BOOT, tap RESET) is the first-flash/recovery path.
# Flash size is provisional pending the actual pedal board being finalized —
# adjust if the chosen board ships more.
CONFIG_ESPTOOLPY_FLASHSIZE_4MB=y
CONFIG_ESPTOOLPY_FLASHSIZE="4MB"
CONFIG_PARTITION_TABLE_CUSTOM=y
CONFIG_PARTITION_TABLE_CUSTOM_FILENAME="partitions.csv"

# Compile the ESP-IDF C side (FreeRTOS, drivers, TinyUSB) for speed — the USB
# device task and (once Phase 2 lands) the loadcell/motor driver live there.
CONFIG_COMPILER_OPTIMIZATION_PERF=y

# A failed boot after an OTA rolls back to the previous slot; the running
# image confirms itself via esp_ota_mark_app_valid_cancel_rollback().
CONFIG_BOOTLOADER_APP_ROLLBACK_ENABLE=y
```

## firmware/sdkconfig.defaults
```kconfig
# --- pithddu defaults (ESP32-S3, Rust build) ---

# Console on UART0: the native USB-OTG peripheral is owned by our TinyUSB
# composite device (CDC + HID) and shares the D+/D- pins with USB-Serial-JTAG, so
# console can't use USB. Attach a 3.3V USB-UART adapter to UART0 to see logs.
CONFIG_ESP_CONSOLE_UART_DEFAULT=y

# Headroom for the main task.
CONFIG_ESP_MAIN_TASK_STACK_SIZE=8192

# 8 MB Octal PSRAM on the XIAO ESP32-S3 (ESP32-S3R8) — holds the two display
# framebuffers (480x320x2 = 300 KB each, added in Phase 4).
CONFIG_SPIRAM=y
CONFIG_SPIRAM_MODE_OCT=y
CONFIG_SPIRAM_SPEED_80M=y
# Add PSRAM to the regular heap so the 300 KB display framebuffers allocate there
# (large allocations spill to PSRAM; small ones stay in fast internal RAM).
CONFIG_SPIRAM_USE_MALLOC=y
CONFIG_SPIRAM_MALLOC_ALWAYSINTERNAL=4096
CONFIG_ESP_DEFAULT_CPU_FREQ_MHZ_240=y
CONFIG_FREERTOS_HZ=1000

# 8 MB flash with IDF's built-in dual-OTA partition table (nvs + otadata + two
# app slots) so the dashboard can push OTA updates over USB; rollback on a bad
# image so a failed update can't brick the dash. We use TWO_OTA (not a custom
# CSV) because the firmware only needs NVS + OTA (no SPIFFS), and it avoids the
# esp-idf-sys synthetic-project-dir CSV path issue.
CONFIG_ESPTOOLPY_FLASHSIZE_8MB=y
CONFIG_ESPTOOLPY_FLASHSIZE="8MB"
CONFIG_PARTITION_TABLE_TWO_OTA=y
CONFIG_BOOTLOADER_APP_ROLLBACK_ENABLE=y
```
